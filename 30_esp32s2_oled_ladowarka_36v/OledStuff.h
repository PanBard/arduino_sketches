#include <Adafruit_GFX.h>
#include <Adafruit_SSD1306.h> // by Adafruit
#include <Wire.h>  //for custom sda, scl define

//--- oled
#define I2C_SDA 37  // sda
#define I2C_SCL 35  // scl
//--- oled

// OLED setup ---------------------
Adafruit_SSD1306 display(128, 64, &Wire, -1);  // On ESP32 s2 mini:   pin1=(SDA),  pin2=(SCL); VCC=3.3v; Reset pin # (or -1 if sharing Arduino reset pin)
// OLED setup ---------------------
bool is_oled_working;
float v = 0;
void oled_display(String message) {
  display.clearDisplay();                           // Clear display buffer
  display.setTextSize(1);                           // Draw 2X-scale text
  display.setTextColor(SSD1306_WHITE);
  display.setCursor(1, 1);
  display.println(message);
  display.display();  // Update screen
}



void oled_display_content(float voltage_switch, float charge_baterry_voltage_level_detection, float charge_baterry_voltage_level_end, int time, bool charge_end) 
{
  display.clearDisplay();                           // Clear display buffer
  display.setTextColor(SSD1306_WHITE);

if(voltage_switch > charge_baterry_voltage_level_detection &&  charge_end == false)
{
  display.setTextSize(2);    
  display.setCursor(35, 1);
  display.println(voltage_switch,1);
  display.setCursor(90, 1);
  display.println('v');

  display.setTextSize(2);                           // Draw 2X-scale text
  display.setCursor(5, 23);
  display.println("LADOWANIE");
  display.setTextSize(1);
  display.setCursor(1, 45);
  display.print("Czas: ");
  display.print(String(time/3600)+F("h "));
  display.print(String((time%3600)/60)+F("m "));
  display.print(String(time%60)+F("s"));
  // display.println("Czas:");
  // display.setCursor(30, 40);
  // display.println(time);
  // display.setCursor(40, 40);
  // display.println('s');
}
else if(voltage_switch >= charge_baterry_voltage_level_end || charge_end == true)
{
  display.setTextSize(2);    
  display.setCursor(35, 1);
  display.println(voltage_switch,1);
  display.setCursor(90, 1);
  display.println('v');

  display.setTextSize(2);                           // Draw 2X-scale text
  display.setCursor(3, 23);
  display.println("NALADOWANA");
  display.setTextSize(1);
  display.setCursor(1, 45);
  display.print("Czas: ");
  display.print(String(time/3600)+F("h "));
  display.print(String((time%3600)/60)+F("m "));
  display.print(String(time%60)+F("s"));
  // display.println("Czas:");
  // display.setCursor(30, 40);
  // display.println(time);
  // display.setCursor(40, 40);
  // display.println('s');
}
else if( voltage_switch < charge_baterry_voltage_level_detection )
{
  display.setTextSize(1);                           // Draw 2X-scale text
  display.setCursor(1, 23);
  display.println("Nie wykryto baterii!");
  // display.setCursor(50, 23);
  // display.println(voltage_switch,1);
  // display.setCursor(70, 23);
  // display.println('v');
}

  // display.setCursor(1, 20);
  // display.println("general:");
  // display.setCursor(50, 20);
  // display.println(analog_value_general);

  // display.setCursor(1, 40);
  // display.println("switch:");
  // display.setCursor(50, 40);
  // display.println(analog_value_switch);



  display.display();  // Update screen
}

const unsigned char Autobot_logo_v2[] PROGMEM = {
  0x00, 0x03, 0xff, 0xff, 0xff, 0xf0, 0x00, 0x00, 0x00, 0x03, 0xfc, 0x00, 0x1f, 0xf0, 0x00, 0x00, 
	0xff, 0x9f, 0x00, 0x00, 0x00, 0x3f, 0x1f, 0xf0, 0x00, 0xb0, 0x00, 0x00, 0x00, 0x03, 0xdf, 0xf0, 
	0xc0, 0xa0, 0x00, 0x00, 0x00, 0x00, 0xf0, 0x30, 0xc0, 0xb0, 0x01, 0xff, 0xf0, 0x00, 0xf0, 0x30, 
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	0x00, 0x00, 0x0f, 0x7f, 0xf6, 0x00, 0x00, 0x00, 0x00, 0x00, 0x03, 0xff, 0xf0, 0x00, 0x00, 0x00

};


void displayTransformersLogo_v2() {
  display.clearDisplay();
  display.drawBitmap(30, 0, Autobot_logo_v2, 60, 60, 1);  //(x,y,bitmap_name,width,height,1)
  display.display();
  delay(1000);
};

void oled_start() {
  Wire.begin(I2C_SDA, I2C_SCL);                      //Wire.begin(I2C_SDA, I2C_SCL);
  if (!display.begin(SSD1306_SWITCHCAPVCC, 0x3C)) //See datasheet for Address; 0x3D for 128x64, 0x3C for 128x32
  {  
    // Serial.println(F("SSD1306 allocation failed"));
    is_oled_working = false;
    // for (;;);  // Don't proceed, loop forever
  }
  else
  {
    is_oled_working = true;
    // Serial.println("oled display status: ok");
    display.clearDisplay();
    displayTransformersLogo_v2();

  }
}